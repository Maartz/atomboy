/* The Game Boy, on the silicon, on a panel.
 *
 * Everything below the calling convention is generated by `lib/atomboy/native/`
 * and emitted as RV32I by Elixir: the 501 opcode handlers, the ALU's flag
 * arithmetic, the DMG scanline renderer, the 154-line frame cadence, the
 * cartridge's bank switching. None of it knows this file exists, and this file
 * knows none of it -- the whole seam is a pointer in and a pointer out.
 *
 *     uint32_t entry(void *argument)
 *
 * What comes back points at five words: status, the opcode it stopped on,
 * T-cycles run, the framebuffer, and the emulated 64 KB. Calling again
 * continues the same console -- the blob writes its CPU state back before it
 * returns, so the copy this file holds *is* the machine.
 *
 * Before any of it is trusted, the frame is checksummed against what the BEAM
 * emulator draws for the same ROM. Pixels one already trusts are the only kind
 * worth debugging an SPI bus with.
 */

#include <stdio.h>
#include <string.h>

#include "driver/gpio.h"
#include "driver/i2c_master.h"
#include "driver/spi_master.h"
#include "esp_cpu.h"
#include "esp_heap_caps.h"
#include "esp_lcd_panel_io.h"
#include "esp_lcd_panel_ops.h"
#include "esp_lcd_ili9341.h"
#include "esp_lcd_panel_vendor.h"
#include "esp_log.h"
#include "esp_rom_crc.h"
#include "freertos/FreeRTOS.h"
#include "freertos/task.h"

static const char *TAG = "atomboy";

extern const uint8_t blob_start[] asm("_binary_blob_bin_start");
extern const uint8_t blob_end[] asm("_binary_blob_bin_end");

/* Waveshare 2.4" ILI9341, 240x320, four-wire SPI. */
#define PIN_CLK 6
#define PIN_DIN 7
#define PIN_CS 10
#define PIN_DC 11
#define PIN_RST 18
#define PIN_BL 19

#define PANEL_W 240
#define PANEL_H 320

/* 10 MHz, and deliberately slow. These modules take 40 and often 80, but only
 * on a board where the traces are traces. On loose jumper wires 40 MHz is a
 * coin toss: the clock rings, the data is sampled wrong, the panel ignores
 * every command and stays in the white it powered up in -- which is exactly
 * what it did. Speed is the last thing to raise, not the first. */
#define SPI_HZ (20 * 1000 * 1000)

#define GB_W 160
#define GB_H 144
#define GB_PIXELS (GB_W * GB_H)

/* Centred, at 1:1. Two of 160 is 320 and the panel is 240 across in this
 * orientation, so the only integer scale that fits is one -- and an integer
 * scale is the only kind that leaves pixel art looking like itself. */
/* Three output pixels for every two of the Game Boy's: 240x216, which takes
 * the panel's full width. It is the largest that fits -- doubling would want
 * 320x288 and there are 240 across -- and 3:2 is the only non-integer ratio
 * worth having, because every source pixel becomes a whole number of
 * destination ones. No pixel is dropped and none is blurred; some are simply
 * twice as wide as their neighbour, which reads as texture rather than as
 * damage. */
#define OUT_W (GB_W * 3 / 2)
#define OUT_H (GB_H * 3 / 2)
#define OUT_PIXELS (OUT_W * OUT_H)

#define ORIGIN_X ((PANEL_W - OUT_W) / 2)
#define ORIGIN_Y ((PANEL_H - OUT_H) / 2)

/* The pinned checksum is the tenth frame -- test/native_machine_test.exs,
 * @hero_crc -- and the blob is built for one frame a call. */
#define FRAMES_PINNED 10
/* Eight buttons on a PCF8574, two wires. The chip's pins idle high through
 * their own weak pull-ups and a button shorts one to ground, so a pressed key
 * reads as a *zero* -- the byte comes back inverted and is inverted again here.
 *
 * The bit order is Potion's, not the hardware's: right, left, up, down, A, B,
 * select, start. `Atomboy.Native.Machine`'s joypad seam splits it into the two
 * rows the DMG's matrix actually has.
 */
#define PIN_SDA 4
#define PIN_SCL 5

#define HERO_CRC 0x5AA2E5B7u

/* The pinned frame belongs to hero.gb. Any other cartridge draws its own, and
 * comparing against a checksum from a different ROM would only ever say
 * DIVERGENT -- which is noise, not a finding. */
#define CHECK_CRC 0

static const char *button_names[8] = {"right", "left", "up",     "down",
                                      "A",     "B",    "select", "start"};

/* Walks the bus and returns the first address that answers. Nothing here is
 * guessed: a datasheet says 0x20 and the solder says what it says. */
static int i2c_scan(i2c_master_bus_handle_t bus) {
  int found = -1;

  for (uint8_t address = 0x08; address < 0x78; address++) {
    if (i2c_master_probe(bus, address, 50) == ESP_OK) {
      ESP_LOGI(TAG, "I2C: something answers at 0x%02X", address);
      if (found < 0) {
        found = address;
      }
    }
  }

  if (found < 0) {
    ESP_LOGE(TAG, "I2C: nobody answered on SDA %d / SCL %d", PIN_SDA, PIN_SCL);
  }

  return found;
}

struct result {
  uint32_t status;
  uint32_t opcode;
  uint32_t cycles;
  uint32_t framebuffer;
  uint32_t memory;
};

typedef uint32_t (*atomboy_entry_t)(void *argument);

/* The DMG's four greens, as the shell on the laptop draws them. The renderer
 * emits a shade index per pixel and never a colour: what a shade looks like is
 * a decision for whoever owns the screen, which here is this file. */
static const uint8_t dmg[4][3] = {
    {0x9B, 0xBC, 0x0F}, {0x8B, 0xAC, 0x0F}, {0x30, 0x62, 0x30}, {0x0F, 0x38, 0x0F}};

static uint16_t palette[4];

/* RGB565, stored big-endian: the ILI9341 takes the high byte first and this
 * processor is little-endian, so the swap has to happen somewhere. Doing it
 * once per shade beats doing it 23040 times per frame. */
static uint16_t rgb565_be(const uint8_t rgb[3]) {
  const uint16_t value = ((rgb[0] >> 3) << 11) | ((rgb[1] >> 2) << 5) | (rgb[2] >> 3);
  return (uint16_t)((value >> 8) | (value << 8));
}

static esp_lcd_panel_handle_t panel_open(void) {
  gpio_config_t backlight = {.mode = GPIO_MODE_OUTPUT, .pin_bit_mask = 1ULL << PIN_BL};
  ESP_ERROR_CHECK(gpio_config(&backlight));
  gpio_set_level(PIN_BL, 0);

  spi_bus_config_t bus = {
      .sclk_io_num = PIN_CLK,
      .mosi_io_num = PIN_DIN,
      .miso_io_num = -1,
      .quadwp_io_num = -1,
      .quadhd_io_num = -1,
      /* One frame in one transfer: 160x144 at two bytes a pixel. */
      .max_transfer_sz = OUT_PIXELS * 2 + 8,
  };
  ESP_ERROR_CHECK(spi_bus_initialize(SPI2_HOST, &bus, SPI_DMA_CH_AUTO));

  esp_lcd_panel_io_handle_t io = NULL;
  esp_lcd_panel_io_spi_config_t io_config = {
      .dc_gpio_num = PIN_DC,
      .cs_gpio_num = PIN_CS,
      .pclk_hz = SPI_HZ,
      .lcd_cmd_bits = 8,
      .lcd_param_bits = 8,
      .spi_mode = 0,
      .trans_queue_depth = 10,
  };
  ESP_ERROR_CHECK(esp_lcd_new_panel_io_spi((esp_lcd_spi_bus_handle_t)SPI2_HOST, &io_config, &io));

  esp_lcd_panel_handle_t panel = NULL;
  esp_lcd_panel_dev_config_t panel_config = {
      .reset_gpio_num = PIN_RST,
      .rgb_ele_order = LCD_RGB_ELEMENT_ORDER_BGR,
      .bits_per_pixel = 16,
  };
  ESP_ERROR_CHECK(esp_lcd_new_panel_ili9341(io, &panel_config, &panel));

  ESP_ERROR_CHECK(esp_lcd_panel_reset(panel));
  ESP_ERROR_CHECK(esp_lcd_panel_init(panel));
  ESP_ERROR_CHECK(esp_lcd_panel_invert_color(panel, false));

  /* Tetris came up with its text reading backwards. The ILI9341's column
   * address order is the panel's business, not the emulator's -- nothing about
   * the framebuffer changes. */
  ESP_ERROR_CHECK(esp_lcd_panel_mirror(panel, true, false));
  ESP_ERROR_CHECK(esp_lcd_panel_disp_on_off(panel, true));

  gpio_set_level(PIN_BL, 1);
  return panel;
}

/* Three solid screens before anything subtle, and the *whole* panel each time.
 * Painting only the centre proves nothing: the 240x320 around it is never
 * written, so it keeps whatever it powered up in, and a panel that ignored
 * every command looks identical to one that obeyed them.
 *
 * Read what happens, in this order:
 *
 *   red, green, blue      byte order and colour order are both right
 *   blue, green, red      LCD_RGB_ELEMENT_ORDER_BGR above is inverted
 *   still white           no command is landing: wiring, or SPI still too fast
 *   noise or tearing      data lands but is sampled wrong: slower still
 *
 * A line at a time, because one screenful is 150 KB and the bus config only
 * promises a frame's worth. */
static void panel_prove(esp_lcd_panel_handle_t panel, uint16_t *scratch) {
  static const uint8_t primaries[3][3] = {{0xFF, 0, 0}, {0, 0xFF, 0}, {0, 0, 0xFF}};

  for (int i = 0; i < 3; i++) {
    const uint16_t colour = rgb565_be(primaries[i]);

    for (int x = 0; x < PANEL_W; x++) {
      scratch[x] = colour;
    }

    for (int y = 0; y < PANEL_H; y++) {
      ESP_ERROR_CHECK(esp_lcd_panel_draw_bitmap(panel, 0, y, PANEL_W, y + 1, scratch));
    }

    ESP_LOGI(TAG, "painted the whole panel %s", i == 0 ? "red" : i == 1 ? "green" : "blue");
    vTaskDelay(pdMS_TO_TICKS(1200));
  }
}

void app_main(void) {
  for (int i = 0; i < 4; i++) {
    palette[i] = rgb565_be(dmg[i]);
  }

  const size_t size = (size_t)(blob_end - blob_start);
  ESP_LOGI(TAG, "blob: %u bytes of generated RV32I, code and data", (unsigned)size);

  /* Internal RAM, word aligned, and executable because sdkconfig.defaults takes
   * the PMP split off -- the C6's HP SRAM answers to both buses at one address,
   * but ESP-IDF marks the data half non-executable unless told otherwise. */
  void *executable = heap_caps_aligned_alloc(4, size, MALLOC_CAP_INTERNAL | MALLOC_CAP_8BIT);
  uint16_t *pixels = heap_caps_malloc(OUT_PIXELS * 2, MALLOC_CAP_DMA);

  if (executable == NULL || pixels == NULL) {
    ESP_LOGE(TAG, "out of memory: %u bytes of code, %u of pixels", (unsigned)size, OUT_PIXELS * 2);
    return;
  }

  memcpy(executable, blob_start, size);

  /* Written through the data bus, about to be fetched through the instruction
   * one. Without the fence the processor may run whatever was there before. */
  __asm__ volatile("fence.i" ::: "memory");

  esp_lcd_panel_handle_t panel = panel_open();
  panel_prove(panel, pixels);

  i2c_master_bus_config_t i2c_bus = {
      .i2c_port = -1,
      .sda_io_num = PIN_SDA,
      .scl_io_num = PIN_SCL,
      .clk_source = I2C_CLK_SRC_DEFAULT,
      .glitch_ignore_cnt = 7,
      .flags.enable_internal_pullup = true,
  };
  i2c_master_bus_handle_t bus = NULL;
  ESP_ERROR_CHECK(i2c_new_master_bus(&i2c_bus, &bus));

  const int address = i2c_scan(bus);
  i2c_master_dev_handle_t pad = NULL;

  if (address >= 0) {
    i2c_device_config_t device = {
        .dev_addr_length = I2C_ADDR_BIT_LEN_7,
        .device_address = (uint16_t)address,
        .scl_speed_hz = 400000,
    };
    ESP_ERROR_CHECK(i2c_master_bus_add_device(bus, &device, &pad));

    /* The PCF8574 is quasi-bidirectional: a pin can only be read as an input
     * once it has been written high, because reading is really "see whether
     * something is pulling my weak pull-up down". Power-on leaves the port at
     * 0xFF, so this works by luck without the line below -- and one stray zero
     * written to a pin would make that button mute for good. */
    const uint8_t all_high = 0xFF;
    ESP_ERROR_CHECK(i2c_master_transmit(pad, &all_high, 1, 50));

    ESP_LOGI(TAG, "pad: PCF8574 at 0x%02X -- press something", address);
  }

  uint8_t last = 0;
  unsigned ticks = 0;

  /* What the blob is told this frame. Contacts bounce -- the log showed a held
   * A flickering off and back within two frames -- so a bit that goes on stays
   * on for a couple of frames after the contact opens. Favouring the press over
   * the release is the right way round for a game: a dropped input is felt, an
   * input held one frame too long is not. */
  uint8_t pressed = 0;
  uint8_t linger[8] = {0};

  const atomboy_entry_t entry = (atomboy_entry_t)executable;
  int batches = 0;

  while (1) {
    const uint32_t before = esp_cpu_get_cycle_count();
    const struct result *result = (const struct result *)entry((void *)(uintptr_t)pressed);
    const uint32_t emulated = esp_cpu_get_cycle_count() - before;

    if (result->status != 0) {
      ESP_LOGE(TAG, "stopped on an opcode it does not know: 0x%02lx", (unsigned long)result->opcode);
      return;
    }

    const uint8_t *shades = (const uint8_t *)result->framebuffer;

    /* The one check worth making before the panel is believed -- and made after
     * ten batches rather than one, because the pinned checksum is hero.gb's
     * tenth frame. Reaching it through ten separate calls tests something one
     * call of ten frames could not: that the blob really does write its state
     * back, and that call eleven continues the console rather than rebooting
     * it. Past that the frame is legitimately a different one. */
    if (CHECK_CRC && ++batches == FRAMES_PINNED) {
      const uint32_t crc = esp_rom_crc32_le(0, shades, GB_PIXELS);

      ESP_LOGI(TAG, "frame CRC 0x%08lX -- the BEAM emulator says 0x%08X", (unsigned long)crc,
               HERO_CRC);

      if (crc == HERO_CRC) {
        ESP_LOGI(TAG, "IDENTICAL: the same pixels, on a laptop and on this chip");
      } else {
        ESP_LOGE(TAG, "DIVERGENT: the chip drew something else");
      }
    }

    /* Scale and colour in one pass. The 2/3 division is integer and lands on
     * the pattern 0,0,1,1,2,3,3,4,4,5 -- two source pixels stretched into
     * three, forever. */
    for (int y = 0; y < OUT_H; y++) {
      const uint8_t *row = shades + (y * 2 / 3) * GB_W;
      uint16_t *out = pixels + y * OUT_W;

      for (int x = 0; x < OUT_W; x++) {
        out[x] = palette[row[x * 2 / 3] & 3];
      }
    }

    /* One byte a frame, which is also how often a DMG polls its own pad. The
     * chip reports a pressed key as zero, so this is the byte the emulator
     * wants only after it has been turned over. */
    if (pad != NULL) {
      uint8_t raw = 0xFF;
      const esp_err_t read = i2c_master_receive(pad, &raw, 1, 20);

      /* Say the raw byte out loud once a second whatever happens. Logging only
       * on change cannot tell "nothing pressed" from "the read failed", and
       * that ambiguity has already cost one debugging session on the panel.
       * With no button wired the byte is 0xFF; a pin pulled to ground turns
       * its bit off. */
      if (++ticks % 60 == 0) {
        if (read == ESP_OK) {
          ESP_LOGI(TAG, "pad raw 0x%02X (0xFF is nothing held)", raw);
        } else {
          ESP_LOGE(TAG, "pad read failed: %s", esp_err_to_name(read));
        }
      }

      if (read == ESP_OK) {
        const uint8_t held = (uint8_t)~raw;

        pressed = 0;

        for (int b = 0; b < 8; b++) {
          if (held & (1 << b)) {
            linger[b] = 3;
          }

          if (linger[b] > 0) {
            linger[b]--;
            pressed |= (uint8_t)(1 << b);
          }
        }

        if (held != last) {
          char line[64] = "";

          for (int b = 0; b < 8; b++) {
            if (held & (1 << b)) {
              strcat(line, button_names[b]);
              strcat(line, " ");
            }
          }

          ESP_LOGI(TAG, "pad 0x%02X: %s", held, line[0] ? line : "(nothing)");
          last = held;
        }
      }
    }

    const uint32_t drawn = esp_cpu_get_cycle_count() - before;

    ESP_ERROR_CHECK(esp_lcd_panel_draw_bitmap(panel, ORIGIN_X, ORIGIN_Y, ORIGIN_X + OUT_W,
                                              ORIGIN_Y + OUT_H, pixels));

    ESP_LOGI(TAG, "%lu us emulating, %lu us to the palette", (unsigned long)(emulated / 160u),
             (unsigned long)((drawn - emulated) / 160u));
  }
}
